## sdkconfig.defaults
```kconfig
CONFIG_FREERTOS_HZ=1000
CONFIG_FATFS_LFN_STACK=y
CONFIG_LV_COLOR_16_SWAP=y
CONFIG_MBEDTLS_PSK_MODES=y
CONFIG_MBEDTLS_KEY_EXCHANGE_PSK=y
CONFIG_PARTITION_TABLE_SINGLE_APP_LARGE=y
CONFIG_ESPTOOLPY_FLASHSIZE_16MB=y
CONFIG_ESP_COREDUMP_ENABLE_TO_UART=y
CONFIG_ESP32S3_DEFAULT_CPU_FREQ_240=y
```
